// SPDX-License-Identifier: (GPL-2.0+ OR MIT)
/*
 * Copyright (c) 2023 Edgeble AI Technologies Pvt. Ltd.
 *
 * Edgeble Neu6B CAM2-IMX415.
 */


/dts-v1/;
/plugin/;

&i2c8 {
	pinctrl-names = "default";
        pinctrl-0 = <&i2c8m3_xfer>;
        status = "okay";
};
